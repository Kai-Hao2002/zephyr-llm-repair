/ {
	test_latch: gpio@8fffff00 {
		compatible = "gpio-mmio-latch";
		reg = <0x8fffff00 0x4>;
		gpio-controller;
		#gpio-cells = <2>;
		ngpios = <8>;
		initial-output = <0x5a>;
		status = "okay";
	};
};

&ram0 {
	reg = <0x80000000 0xfffff00>;
};
